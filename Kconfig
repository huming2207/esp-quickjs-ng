## Kconfig
```kconfig
menu "QuickJS-NG"

    config QJS_ESP_HEAP_PREFER_PSRAM
        bool "Put the JS heap in PSRAM"
        depends on SPIRAM
        default y
        help
            qjs_esp_new_runtime() allocates from PSRAM first and falls back
            to internal RAM.

    config QJS_ESP_STACK_MARGIN
        int "Stack kept free for native code (bytes)"
        range 1024 65536
        default 4096
        help
            qjs_esp_new_runtime() sets the JS recursion limit to the task's
            free stack minus this. Native calls made at max JS depth (printf,
            TLS writes...) run in this space.

    config QJS_ESP_INTERRUPT_INTERVAL
        int "Interrupt check interval (interrupt points)"
        range 1 10000
        default 100
        help
            A count, not a time: QuickJS runs the interrupt handler (stop,
            deadline, slice and yield checks) after this many interrupt
            points, i.e. loop back-jumps, function calls and iterations of a
            few array builtins. Upstream uses 10000. Other builtins don't
            count, so a loop doing one heavy builtin per iteration (fill() on
            a big array, say) can overrun the slice by about half this many
            builtin calls. Each check costs a function call and a cycle
            counter read; the real clock is read about once per millisecond.
            In examples/bench (S31, esp-emu) 100 costs well under 1%, 10
            about 1%, 1 about 12%. Lower it if overruns matter more.

    menu "Bytecode"

        config QJS_ESP_BC_COMPILE
            bool "Compile to bytecode on the device"
            default y
            help
                qjs_esp_bc_compile(): source in, bytecode container out, to
                cache a parsed script in flash for instance. Turn it off when
                bytecode always comes from a host (tools/qjs_esp_bc.py).
                JS_Eval() of plain source works either way.

        config QJS_ESP_BC_LOAD
            bool "Load bytecode"
            default y
            help
                qjs_esp_bc_eval(). QuickJS doesn't check bytecode at all: a
                damaged or hostile blob can corrupt any memory, and the arena
                won't help. Only load what you compiled and kept where nobody
                else can write. There's no signature check (yet).
    endmenu

    config QJS_ESP_EVENT_QUEUE_LEN
        int "Event queue length"
        range 4 256
        default 16

    config QJS_ESP_MOD_UDP
        bool "udp module"
        default y

    config QJS_ESP_MOD_POSIX_SOCKET
        bool "posix-socket module"
        default y

    config QJS_ESP_MOD_WS
        bool "ws (WebSocket client) module"
        default y

    menu "Socket I/O"
        depends on QJS_ESP_MOD_UDP || QJS_ESP_MOD_POSIX_SOCKET

        config QJS_ESP_IO_MAX_WATCHERS
            int "Max sockets watched at once"
            range 1 64
            default 8

        config QJS_ESP_IO_TASK_STACK
            int "I/O task stack size"
            range 2048 16384
            default 3072

        config QJS_ESP_IO_TASK_PRIO
            int "I/O task priority"
            default 5

        config QJS_ESP_RX_BUF_SIZE
            int "Receive buffer size"
            range 512 65536
            default 2048
            help
                One buffer, shared by all sockets (reads happen in the JS
                task). Bigger UDP datagrams are truncated and flagged partial.
    endmenu

    menu "WebSocket"
        depends on QJS_ESP_MOD_WS

        config QJS_ESP_WS_MAX_OPEN
            int "Max open websockets"
            range 1 32
            default 4
            help
                Each open websocket has an eventfd so its task can block in
                select() instead of polling (lets the chip light-sleep). This
                sizes the eventfd table, if nobody registered it before us.
                One more than this fails with EMFILE.

        config QJS_ESP_WS_MAX_MESSAGE
            int "Max message size"
            range 256 1048576
            default 4096
            help
                Per-connection receive buffer, allocated when connecting.
                Bigger messages close the connection with 1009.

        config QJS_ESP_WS_TX_CHUNK
            int "Send buffer size"
            range 128 4096
            default 1024
            help
                Per-connection send buffer, allocated when connecting.
                Bigger messages go out as several frames (RFC 6455
                fragmentation). The transport masks the payload in place, so
                JS memory is never handed to it directly. Keep it at or below
                the mbedTLS max out fragment length.

        config QJS_ESP_WS_TASK_STACK
            int "Connection task stack size"
            range 4096 32768
            default 6144
            help
                One task per open websocket. It does DNS, the TLS handshake
                and reads.

        config QJS_ESP_WS_TASK_STACK_PSRAM
            bool "Put connection task stacks in PSRAM"
            depends on SPIRAM && FREERTOS_TASK_CREATE_ALLOW_EXT_MEM
            default n
            help
                Saves internal RAM. Fine as long as nothing in the task
                touches flash with the cache disabled (esp_transport doesn't).

        config QJS_ESP_WS_TASK_PRIO
            int "Connection task priority"
            default 5

        config QJS_ESP_WS_CONNECT_TIMEOUT_MS
            int "Connect timeout (ms)"
            range 1000 120000
            default 10000

        config QJS_ESP_WS_IO_TIMEOUT_MS
            int "Send / partial frame timeout (ms)"
            range 100 60000
            default 5000
    endmenu

endmenu
```

## examples/network/main/Kconfig.projbuild
```kconfig
menu "Example"
    config EXAMPLE_ECHO_HOST
        string "Echo server address"
        default "10.0.2.1"
        help
            Where tools/echo_server.py runs. 10.0.2.1 is the host as seen from
            esp-emu with --net user,net=10.0.2.0/24.
endmenu
```
